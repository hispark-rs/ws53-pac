# WS53 register map
File version: 0.1.0-experimental
Registers are 32-bit, read-write, no defined reset value unless marked. A register's access mark holds for its fields unless they carry their own. Offsets are from the block's base; [hi:lo] are bit positions; lines under a group give offsets from that group; {n}, {i} and the like mark numbered series.

## PWM
Base 0x52082000
0x00 PWM_SEL0
  [15:0] PWM_SEL_0 — Group 0 PWM select, each bit corresponds to one PWM channel
{0x4+0x10*i} PWM_STARTCLRCNT_EN{i} (i=0..3)
  [0] PWM_STARTCLRCNT_EN_{i} — Start clear counter enable for group {i}
0x08 PWM_START0 wo
  [0] PWM_START_0 range 1..1 — Commit group 0 configuration with 1; do not assume synchronous acceptance. A-board2MHz finite8/16 bursts required guarding the initial enabled configuration before EN-clear;10us guard passed. Exact acceptance latency and command readback unverified; see evidence/ws53-pwm-start-hil.json
{0x0+0x10*i} PWM_SEL{i} (i=1..3)
  [15:0] PWM_SEL_{i} — Group {i} PWM select
{0x8+0x10*i} PWM_START{i} wo (i=1..3)
  [0] PWM_START_{i} range 1..1 — Commit group {i} configuration with 1; SDK has no completion poll, self-clear/readback timing unverified
0x100 PWM_EN0
  [0] PWM_EN_0 — PWM0 enable: 0=off; 1=on
    0=Off (PWM disabled, output low); 1=On (PWM enabled)
0x104 PWM_PORTITY0
  [0] PWM_POARITY_0 — PWM0 polarity: 0=normal; 1=inverted
    0=Normal polarity; 1=Inverted polarity
0x108 PWM_OEN_CFG0
  [0] PWM_OEN_CFG_0 — PWM0 high-Z enable: 0=follow polarity; 1=high-Z when inactive
0x10C PWM_OFFSET_L0
  [15:0] PWM_OFFSET_L_0 — PWM0 phase offset low 16 bits
0x110 PWM_OFFSET_H0
  [15:0] PWM_OFFSET_H_0 — PWM0 phase offset high 16 bits
0x114 PWM_FREQ_L0
  [15:0] PWM_FREQ_L_0 — PWM0 clock divider low 16 bits
0x118 PWM_FREQ_H0
  [15:0] PWM_FREQ_H_0 — PWM0 clock divider high 16 bits
0x11C PWM_DUTY_L0
  [15:0] PWM_DUTY_L_0 — PWM0 duty cycle low 16 bits
0x120 PWM_DUTY_H0
  [15:0] PWM_DUTY_H_0 — PWM0 duty cycle high 16 bits
0x124 PWM_PERIODLOAD_FLAG0 ro
  [0] PWM_PERIODLOAD_FLAG_0 — Configuration-load notification; A-board flag=1 and count=1 during first pulse after START, before 8/16-pulse block completion. W1C via CFG_INT_CLR0 clears it; deferred stop later asserts it again. Not an unconditional block-end flag. See evidence/ws53-pwm-load-flag-hil.json
0x128 PWM_PERIOD_VAL0
  [15:0] PWM_PERIOD_VAL_0 — Pulse count for stepping mode
0x12C PWM_PERIODCNT0 ro
  [15:0] PWM_PERIODCNT_0 — A-board finite8/16 PWM0 at2MHz: active pulse index is1-based during each100us period, then0 after deferred stop. Boundary, continuous, repeating and overflow semantics unverified; see evidence/ws53-pwm-counter-hil.json
0x140 PWM_EN1
  [0] PWM_EN_1 — PWM1 enable
0x144 PWM_PORTITY1
  [0] PWM_POARITY_1 — PWM1 polarity
0x148 PWM_OEN_CFG1
  [0] PWM_OEN_CFG_1 — PWM1 high-Z enable
0x14C PWM_OFFSET_L1
  [15:0] PWM_OFFSET_L_1 — PWM1 phase offset low 16 bits
0x150 PWM_OFFSET_H1
  [15:0] PWM_OFFSET_H_1 — PWM1 phase offset high 16 bits
0x154 PWM_FREQ_L1
  [15:0] PWM_FREQ_L_1 — PWM1 clock divider low 16 bits
0x158 PWM_FREQ_H1
  [15:0] PWM_FREQ_H_1 — PWM1 clock divider high 16 bits
0x15C PWM_DUTY_L1
  [15:0] PWM_DUTY_L_1 — PWM1 duty low 16 bits
0x160 PWM_DUTY_H1
  [15:0] PWM_DUTY_H_1 — PWM1 duty high 16 bits
0x164 PWM_PERIODLOAD_FLAG1 ro
  [0] PWM_PERIODLOAD_FLAG_1 — Period load flag
0x168 PWM_PERIOD_VAL1
  [15:0] PWM_PERIOD_VAL_1 — Pulse count
{0x12C+0x40*i} PWM_PERIODCNT{i} ro (i=1..7)
  [15:0] PWM_PERIODCNT_{i} — Current pulse count
{0x100+0x40*i} PWM_EN{i} (i=2..7)
  [0] PWM_EN_{i} — PWM0 enable: 0=off; 1=on
    0=Off (PWM disabled, output low); 1=On (PWM enabled)
{0x104+0x40*i} PWM_PORTITY{i} (i=2..7)
  [0] PWM_POARITY_{i} — PWM0 polarity: 0=normal; 1=inverted
    0=Normal polarity; 1=Inverted polarity
{0x108+0x40*i} PWM_OEN_CFG{i} (i=2..7)
  [0] PWM_OEN_CFG_{i} — PWM0 high-Z enable: 0=follow polarity; 1=high-Z when inactive
{0x10C+0x40*i} PWM_OFFSET_L{i} (i=2..7)
  [15:0] PWM_OFFSET_L_{i} — PWM0 phase offset low 16 bits
{0x110+0x40*i} PWM_OFFSET_H{i} (i=2..7)
  [15:0] PWM_OFFSET_H_{i} — PWM0 phase offset high 16 bits
{0x114+0x40*i} PWM_FREQ_L{i} (i=2..7)
  [15:0] PWM_FREQ_L_{i} — PWM0 clock divider low 16 bits
{0x118+0x40*i} PWM_FREQ_H{i} (i=2..7)
  [15:0] PWM_FREQ_H_{i} — PWM0 clock divider high 16 bits
{0x11C+0x40*i} PWM_DUTY_L{i} (i=2..7)
  [15:0] PWM_DUTY_L_{i} — PWM0 duty cycle low 16 bits
{0x120+0x40*i} PWM_DUTY_H{i} (i=2..7)
  [15:0] PWM_DUTY_H_{i} — PWM0 duty cycle high 16 bits
{0x124+0x40*i} PWM_PERIODLOAD_FLAG{i} ro (i=2..7)
  [0] PWM_PERIODLOAD_FLAG_{i} — Period load complete flag
{0x128+0x40*i} PWM_PERIOD_VAL{i} (i=2..7)
  [15:0] PWM_PERIOD_VAL_{i} — Pulse count for stepping mode
0x500 PWM_ABNOR_STATE0 ro
  [15:0] PWM_ABNOR_STATE0 — Multi-channel config abnormal state, each bit per PWM
0x504 PWM_ABNOR_STATE1 ro
  [15:0] PWM_ABNOR_STATE1 — Counter config abnormal state, each bit per PWM
0x508 PWM_ABNOR_STATE_CLR0 wo
  [15:0] PWM_ABNOR_STATE_CLR0 — SDK writes observed abnormal-group bits to acknowledge their events; command readback/self-clear timing unverified
0x50C PWM_ABNOR_STATE_CLR1 wo
  [15:0] PWM_ABNOR_STATE_CLR1 — SDK writes observed abnormal-count bits to acknowledge their events; command readback/self-clear timing unverified
0x510 PWM_INT_MASK
  [1:0] PWM_INT_MASK — Event enable despite MASK name: bit0 abnormal, bit1 configuration load; 1 permits, 0 masks, confirmed by SDK init writing 3
    0=Disabled (Both event outputs masked); 1=AbnormalOnly (Enable abnormal configuration event); 2=ConfigurationLoadedOnly (Enable configuration-load notification; initial START can also assert it, not proof that a pulse block ended); 3=AllEvents (Enable both event outputs; SDK initialization value)
0x514 PWM_DMA_EN
  [0] PWM_DMA_EN — DMA enable: 0=disabled; 1=enabled
0x518 PWM_CFG_INT_CLR0 wo
  [15:0] PWM_CFG_INT_CLR0 — Write channel bit to acknowledge configuration-load notification; initial START also sets this flag on A-board channel0; command readback/self-clear timing unverified
